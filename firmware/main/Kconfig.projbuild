## firmware/main/Kconfig.projbuild
```kconfig
menu "open-plaud"

    choice OPEN_PLAUD_BOARD_VARIANT
        prompt "Board variant"
        default OPEN_PLAUD_BOARD_WAVESHARE_LCD154
        help
            Select the hardware pin map and low-level audio/status backend.

        config OPEN_PLAUD_BOARD_WAVESHARE_LCD154
            bool "Waveshare ESP32-S3-LCD-1.54"
            help
                v0 reference board: ES7210 analog microphone ADC, ST7789 LCD,
                and bundled battery SKU.

        config OPEN_PLAUD_BOARD_CUSTOM_REV_A
            bool "Custom PCB Rev A"
            help
                Proposed custom board: direct PDM MEMS microphones and RGB LED
                status, no LCD or ES7210 codec.
    endchoice

    config OPEN_PLAUD_WIFI_SSID
        string "Wi-Fi SSID"
        default ""
        help
            Wi-Fi network name used by the recorder in station mode.

    config OPEN_PLAUD_WIFI_PASSWORD
        string "Wi-Fi password"
        default ""
        help
            Wi-Fi password. Leave empty only for an open network.

    config OPEN_PLAUD_SERVER_URL
        string "Server base URL"
        default "http://192.168.4.2:8000"
        help
            Base URL for the open-plaud server, without a trailing slash.
            Example: http://192.168.1.50:8000 (LAN) or
            https://openplaud.guzus.xyz (Railway, needs TLS).

    config OPEN_PLAUD_AUTH_TOKEN
        string "Server auth bearer token"
        default ""
        help
            Optional shared secret. When set, the device sends
            "Authorization: Bearer <token>" with every upload, matching the
            server's OP_AUTH_TOKEN. Leave empty for an open server.

    config OPEN_PLAUD_WIFI_MAX_RETRIES
        int "Wi-Fi reconnect attempts"
        default 5
        range 1 20

    config OPEN_PLAUD_UPLOAD_TIMEOUT_MS
        int "Upload timeout in milliseconds"
        default 180000
        range 5000 300000
        help
            Upper bound for Wi-Fi connect and HTTP upload operations. Cloud TLS
            uploads from an ESP32 can be slow, especially for queued clips, so
            keep this above the expected full body transfer time.

    config OPEN_PLAUD_COMPRESS_TRANSFERS
        bool "Compress Wi-Fi/BLE transfer payloads with Open Plaud ADPCM"
        default y
        help
            Encode canonical 16-bit PCM WAV clips into the small Open Plaud ADPCM
            transfer container before upload. The server must support
            application/vnd.openplaud.adpcm and decode it back to PCM WAV before
            transcription/storage. Leave off when targeting older servers.

    config OPEN_PLAUD_BLE_COMPANION
        bool "Enable BLE companion service"
        default n
        depends on SOC_BT_SUPPORTED && BT_ENABLED && BT_NIMBLE_ENABLED && BT_CONTROLLER_ENABLED
        select BT_NIMBLE_ROLE_PERIPHERAL
        select BT_NIMBLE_ROLE_BROADCASTER
        help
            Adds the Open Plaud BLE GATT service for an iPhone companion app.
            BLE is for setup/control/status and resumable chunk transfer; Wi-Fi
            remains the primary cloud sync path. Enable Bluetooth -> NimBLE in
            menuconfig first.

    config OPEN_PLAUD_BLE_DEVICE_NAME
        string "BLE companion device name"
        default "Open Plaud"
        depends on OPEN_PLAUD_BLE_COMPANION

    config OPEN_PLAUD_MAX_REC_SECONDS
        int "Max clip length in seconds"
        default 1800
        range 10 7200
        help
            Hold-to-record auto-stops after this many seconds, so a stuck or
            forgotten PLUS button cannot fill the card with one endless WAV.

    config OPEN_PLAUD_AUDIO_READ_MAX_ERRORS
        int "Consecutive audio read failures before abort"
        default 20
        range 1 1000
        help
            Prevents a tight infinite loop if I2S starts returning errors or
            zero-byte reads during bring-up.

    config OPEN_PLAUD_AUDIO_READ_TIMEOUT_MS
        int "Audio read timeout in milliseconds"
        default 500
        range 10 10000
        help
            Finite I2S read timeout; callers can abort clips instead of hanging
            forever on a wedged DMA/clock path.

    config OPEN_PLAUD_IDLE_SLEEP_S
        int "Idle seconds before deep sleep (0 = never sleep) [OPT-IN]"
        default 0
        range 0 3600
        help
            After this many seconds with no button press in the ready/idle
            screen, the device enters deep sleep and wakes on a Record press
            (~2 s back to ready). 0 = NEVER auto-sleep (the default). Sync is
            deliberately not a battery wake source.

            Deep sleep is OPT-IN on the Waveshare board for a hard reason: it
            powers down the USB-Serial/JTAG, and a deep-sleep WAKE does not bring
            it back (only a full reset/power-cycle does). This board has no reset
            button, so once it deep-sleeps it becomes un-reflashable AND
            un-USB-recognizable until the battery is power-cycled. Only set > 0 if
            you accept that, or on a board with a reset button, or once a
            USJ-restore-on-wake fix lands. Other power savings (audio only while
            recording, Wi-Fi off after upload, screen blank while recording) stay
            on regardless.

    config OPEN_PLAUD_REC_SCREEN_S
        int "Seconds before the screen blanks while recording (0 = never)"
        default 10
        range 0 600
        help
            While recording, the LCD backlight turns off after this many seconds
            with no button press to save power; Record/Left turn it back on, and
            Sync turns it back on only while charging. Recording continues
            regardless. 0 keeps the screen on.

    choice OPEN_PLAUD_SDMMC_WIDTH_CHOICE
        prompt "SDMMC bus width"
        default OPEN_PLAUD_SDMMC_WIDTH_4
        help
            4-bit is validated on the Waveshare ESP32-S3-LCD-1.54 (it matches
            Waveshare's own SD example and mounts reliably). 1-bit was not
            re-confirmed with a known-good card during bring-up; prefer 4-bit.

        config OPEN_PLAUD_SDMMC_WIDTH_1
            bool "1-bit"

        config OPEN_PLAUD_SDMMC_WIDTH_4
            bool "4-bit"
    endchoice

    config OPEN_PLAUD_SDMMC_WIDTH
        int
        default 4 if OPEN_PLAUD_SDMMC_WIDTH_4
        default 1

endmenu
```
